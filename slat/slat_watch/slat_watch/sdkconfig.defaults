## slat/slat_watch/slat_watch/sdkconfig.defaults
```kconfig
CONFIG_ESPTOOLPY_FLASHSIZE_4MB=y
CONFIG_ESP_DEFAULT_CPU_FREQ_MHZ_240=y
CONFIG_COMPILER_OPTIMIZATION_PERF=y
CONFIG_FREERTOS_HZ=1000
CONFIG_LWIP_SNTP_UPDATE_DELAY=3600000
```

## slat/slat_watch_seconds/main/Kconfig.projbuild
```kconfig
menu "Slat Watch"
    config SLAT_WIFI_SSID
        string "WiFi SSID"
        default ""
    config SLAT_WIFI_PASS
        string "WiFi password"
        default ""
    config SLAT_NTP_SERVER
        string "NTP server"
        default "pool.ntp.org"
    config SLAT_TZ
        string "POSIX time zone"
        default "UTC0"
        help
            e.g. "CET-1CEST,M3.5.0,M10.5.0/3" (Central Europe),
            "EST5EDT,M3.2.0,M11.1.0" (US Eastern),
            "PST8PDT,M3.2.0,M11.1.0" (US Pacific).
endmenu
```
